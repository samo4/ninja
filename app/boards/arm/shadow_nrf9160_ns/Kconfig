## app/boards/arm/shadow_nrf9160_ns/Kconfig
```kconfig
#
# Copyright (c) 2026 Nordic Semiconductor ASA
#
# SPDX-License-Identifier: LicenseRef-Nordic-5-Clause
#

rsource "Kconfig.shadow_nrf9160_ns"
```

## app/boards/arm/shadow_nrf9160_ns/Kconfig.defconfig
```kconfig
#
# Copyright (c) 2026 Nordic Semiconductor ASA
#
# SPDX-License-Identifier: LicenseRef-Nordic-5-Clause
#

choice TFM_PROFILE_TYPE
	default TFM_PROFILE_TYPE_MINIMAL if BOARD_SHADOW_NRF9160_NS
endchoice
```

## app/boards/arm/shadow_nrf9160_ns/Kconfig.shadow_nrf9160_ns
```kconfig
#
# Copyright (c) 2026 Nordic Semiconductor ASA
#
# SPDX-License-Identifier: LicenseRef-Nordic-5-Clause
#

config BOARD_SHADOW_NRF9160_NS
	bool "Shadow nRF9160 Non-Secure"
	select SOC_NRF9160_SICA
```

## app/boards/arm/shadow_nrf9160_ns/board.yml
```yaml
board:
  name: shadow
  full_name: "Shadow"
  vendor: custom
  socs:
    - name: nrf9160
      variants:
        - name: ns
```

## app/boards/arm/shadow_nrf9160_ns/shadow_nrf9160_ns_defconfig
```kconfig
#
# Copyright (c) 2026 Nordic Semiconductor ASA
#
# SPDX-License-Identifier: LicenseRef-Nordic-5-Clause
#

CONFIG_ARM_MPU=y
CONFIG_ARM_TRUSTZONE_M=y
CONFIG_TRUSTED_EXECUTION_NONSECURE=y
CONFIG_GPIO=y
CONFIG_PWM=y
CONFIG_ENTROPY_NRF5_RNG=n
CONFIG_BOOTLOADER_MCUBOOT=n
CONFIG_BUILD_WITH_TFM=y
```

## app/src/modules/agnss_data/Kconfig.agnss_data
```kconfig
#
# Copyright (c) 2025 Nordic Semiconductor
#
# SPDX-License-Identifier: LicenseRef-Nordic-5-Clause
#

menuconfig APP_AGNSS_DATA
	bool "A-GNSS data module"
	depends on LOCATION
	help
	  Module that handles A-GNSS (Assisted GNSS) assistance requests from
	  the location library. When the GNSS subsystem needs assistance data
	  (ephemerides, almanacs, UTC parameters, etc.), this module fetches
	  the data from a configurable HTTP endpoint (proxy server) and feeds
	  it back to the GNSS subsystem via location_agnss_data_process().

	  This module is designed as a drop-in alternative to nRF Cloud's
	  A-GNSS handling. When enabled, it handles LOCATION_AGNSS_REQUEST
	  messages from the location module independently of nRF Cloud.

if APP_AGNSS_DATA

config APP_AGNSS_DATA_HOST
	string "AGNSS proxy hostname"
	default "balirkaback.azurewebsites.net"
	help
	  Hostname of the A-GNSS proxy server that provides assistance data.

config APP_AGNSS_DATA_PORT
	int "AGNSS proxy port"
	default 443
	range 1 65535
	help
	  Port of the A-GNSS proxy server.

config APP_AGNSS_DATA_URL
	string "AGNSS proxy URL path"
	default "/api/agnss"
	help
	  URL path of the A-GNSS proxy endpoint.
	  The A-GNSS request parameters will be sent to this endpoint.

config APP_AGNSS_DATA_SEC_TAG
	int "AGNSS proxy TLS security tag"
	default 168448
	help
	  Security tag for TLS connection to the A-GNSS proxy server.
	  The corresponding CA certificate must be provisioned.

config APP_AGNSS_DATA_BUFFER_SIZE
	int "AGNSS response buffer size"
	default 3800
	help
	  Maximum size of the A-GNSS data response buffer.
	  The default 3800 bytes matches the nRF Cloud AGNSS data size.

config APP_AGNSS_DATA_THREAD_STACK_SIZE
	int "Thread stack size"
	default 8192
	help
	  Stack size for the A-GNSS data module thread.

config APP_AGNSS_DATA_WATCHDOG_TIMEOUT_SECONDS
	int "Watchdog timeout"
	default 120
	help
	  Timeout in seconds for the A-GNSS data module watchdog.

config APP_AGNSS_DATA_MSG_PROCESSING_TIMEOUT_SECONDS
	int "Maximum message processing time"
	default 60
	help
	  Maximum time allowed for processing a single message.

module = APP_AGNSS_DATA
module-str = A-GNSS data
source "subsys/logging/Kconfig.template.log_config"

endif # APP_AGNSS_DATA
```

## app/src/modules/cloud_post/Kconfig.cloud_post
```kconfig
#
# Copyright (c) 2025 Nordic Semiconductor
#
# SPDX-License-Identifier: LicenseRef-Nordic-5-Clause
#

menuconfig APP_CLOUD_POST
	bool "Cloud POST module"
	depends on REST_CLIENT
	default y
	help
	  Module that collects modem battery voltage and sensor data and
	  sends it as a CSV POST request to a configurable HTTP endpoint.

if APP_CLOUD_POST

config APP_CLOUD_POST_URL
	string "API URL path"
	default "/api/Ninja"
	help
	  URL path of the REST API endpoint.

config APP_CLOUD_POST_THREAD_STACK_SIZE
	int "Thread stack size"
	default 8192

module = APP_CLOUD_POST
module-str = Cloud POST
source "subsys/logging/Kconfig.template.log_config"

endif # APP_CLOUD_POST
```

## app/src/modules/motion/Kconfig.motion
```kconfig
#
# Copyright (c) 2026 Nordic Semiconductor
#
# SPDX-License-Identifier: LicenseRef-Nordic-5-Clause
#

menuconfig APP_MOTION
	bool "Motion module (LIS2DTW12)"
	depends on SPI
  depends on LIS2DW12
	help
	  Enable the motion module, which handles the LIS2DTW12
	  accelerometer / temperature sensor over SPI.

if APP_MOTION

config APP_MOTION_THREAD_STACK_SIZE
	int "Thread stack size"
	default 1024

config APP_MOTION_WATCHDOG_TIMEOUT_SECONDS
	int "Watchdog timeout"
	default 120

config APP_MOTION_MSG_PROCESSING_TIMEOUT_SECONDS
	int "Maximum message processing time"
	default 3

module = APP_MOTION
module-str = MOTION
source "subsys/logging/Kconfig.template.log_config"

endif # APP_MOTION
```
